## drivers/test/nand/nandtest/kconfig.bak
```kconfig
config SUN4I_NANDFLASH_TEST
        depends on BLOCK && ARCH_SUN4I
        tristate "SUN4I Nandflash_test Driver"
        ---help---
          Nand flash driver for SUN4I
```
